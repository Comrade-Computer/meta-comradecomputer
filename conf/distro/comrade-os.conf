## conf/distro/comrade-os.conf
```bitbake
DISTRO = "comrade-os"
DISTRO_NAME = "comrade-os experimental learning distro"
DISTRO_VERSION = "0.0.0+snapshot-${METADATA_REVISION}"
DISTRO_CODENAME = "troubleshooter"
SDK_VENDOR = "-comradesdk"
SDK_VERSION = "${@d.getVar('DISTRO_VERSION').replace('snapshot-${METADATA_REVISION}', 'snapshot')}"
SDK_VERSION[vardepvalue] = "${SDK_VERSION}"

MAINTAINER = "Comrade Computer"

DISTRO_FEATURES:append = " pam"
DISTRO_FEATURES:append = " usrmerge"
DISTRO_FEATURES:append = " gtk+3"
DISTRO_FEATURES:append = " wayland"
DISTRO_FEATURES:append = " vulkan"
DISTRO_FEATURES:append = " ptest"
DISTRO_FEATURES:append = " polkit"
DISTRO_FEATURES:append = " opencl"
DISTRO_FEATURES:append = " nfs"
DISTRO_FEATURES:append = " ipv4"
DISTRO_FEATURES:append = " ipv6"
DISTRO_FEATURES:append = " ipsec"

DISTRO_FEATURES_NATIVESDK:append = " opengl"

DISTRO_EXTRA_RDEPENDS:append = " packagegroup-core-boot"
DISTRO_EXTRA_RRECOMMENDS:append = " kernel-module-af-packet"

TCLIBC = "glibc"
INIT_MANAGER = "systemd"
PACKAGE_CLASSES = "package_rpm"

KERNEL_EXTRA_FEATURES:append = " features/debug/debug-kernel.scc"
```
